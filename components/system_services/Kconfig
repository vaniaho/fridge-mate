## components/system_services/Kconfig
```kconfig
menu "Smart Fridge Configuration"

    menu "WiFi Settings"
        config SMART_FRIDGE_DEFAULT_WIFI_SSID
            string "Default WiFi SSID"
            default ""
            help
                Default WiFi SSID. Can be overridden at runtime via NVS.

        config SMART_FRIDGE_DEFAULT_WIFI_PASS
            string "Default WiFi Password"
            default ""
            help
                Default WiFi password. Can be overridden at runtime via NVS.
    endmenu

    menu "Voice Model Settings"
        comment "ASR / LLM / TTS 三环节默认配置，provider 建议统一为 volcengine"

        config SMART_FRIDGE_DEFAULT_LLM_PROVIDER
            string "Default LLM Provider"
            default "volcengine"
            help
                Provider name, e.g. volcengine, baidu, moonshot, deepseek.

        config SMART_FRIDGE_DEFAULT_LLM_API_URL
            string "Default LLM API URL"
            default "https://ark.cn-beijing.volces.com/api/v3/chat/completions"
            help
                Default LLM API endpoint URL. Can be overridden at runtime via NVS.

        config SMART_FRIDGE_DEFAULT_LLM_API_KEY
            string "Default LLM API Key"
            default ""
            help
                Default LLM API key. Can be overridden at runtime via NVS.
                WARNING: Do not commit real API keys to version control.

        config SMART_FRIDGE_DEFAULT_LLM_MODEL
            string "Default LLM Model Name"
            default "doubao-seed-1.6-250615"
            help
                Default LLM model name used in API requests.

        config SMART_FRIDGE_DEFAULT_LLM_EXTRA
            string "Default LLM Extra Config"
            default ""
            help
                Extra config string, e.g. region, endpoint id.

        config SMART_FRIDGE_DEFAULT_ASR_PROVIDER
            string "Default ASR Provider"
            default "volcengine"
            help
                ASR provider name.

        config SMART_FRIDGE_DEFAULT_ASR_URL
            string "Default ASR API URL"
            default "wss://openspeech.bytedance.com/api/v3/sauc/bigmodel_async"
            help
                Default ASR endpoint URL.

        config SMART_FRIDGE_DEFAULT_ASR_KEY
            string "Default ASR API Key"
            default ""
            help
                Default ASR API key.

        config SMART_FRIDGE_DEFAULT_ASR_MODEL
            string "Default ASR Model"
            default "volc.bigasr.sauc.duration"
            help
                Default ASR model name.

        config SMART_FRIDGE_DEFAULT_ASR_EXTRA
            string "Default ASR Extra Config"
            default ""
            help
                Extra config for ASR, e.g. format=pcm, sample_rate=16000.

        config SMART_FRIDGE_DEFAULT_TTS_PROVIDER
            string "Default TTS Provider"
            default "volcengine"
            help
                TTS provider name.

        config SMART_FRIDGE_DEFAULT_TTS_URL
            string "Default TTS API URL"
            default "wss://openspeech.bytedance.com/api/v3/tts/bidirection"
            help
                Default TTS endpoint URL.

        config SMART_FRIDGE_DEFAULT_TTS_KEY
            string "Default TTS API Key"
            default ""
            help
                Default TTS API key.

        config SMART_FRIDGE_DEFAULT_TTS_MODEL
            string "Default TTS Model"
            default "zh_female_vv_jupiter_bigtts"
            help
                Default TTS model name.

        config SMART_FRIDGE_DEFAULT_TTS_EXTRA
            string "Default TTS Extra Config"
            default "{\"resource_id\":\"seed-tts-2.0\",\"model\":\"seed-tts-2.0-standard\",\"sample_rate\":16000}"
            help
                Extra config for TTS, e.g. voice_id, speed.

        config SMART_FRIDGE_DEFAULT_REALTIME_PROVIDER
            string "Default Realtime Voice Provider"
            default "volcengine"

        config SMART_FRIDGE_DEFAULT_REALTIME_URL
            string "Default Realtime Voice URL"
            default "wss://openspeech.bytedance.com/api/v3/realtime/dialogue"

        config SMART_FRIDGE_DEFAULT_REALTIME_KEY
            string "Default Realtime Voice Access Key"
            default ""

        config SMART_FRIDGE_DEFAULT_REALTIME_MODEL
            string "Default Realtime Voice Model"
            default "1.2.1.1"

        config SMART_FRIDGE_DEFAULT_REALTIME_EXTRA
            string "Default Realtime Voice Extra Config"
            default "{\"appid\":\"\",\"resource_id\":\"volc.speech.dialog\",\"app_key\":\"PlgvMymc7f3tQnJ6\",\"speaker\":\"zh_female_vv_jupiter_bigtts\",\"input_mod\":\"keep_alive\"}"

        config AI_WORKER_STACK_SIZE
            int "AI Worker Task Stack Size"
            default 24576
            help
                Stack size for the AI worker task. LLM HTTPS calls need plenty of stack.

        config AI_WORKER_QUEUE_LEN
            int "AI Worker Queue Length"
            default 4
            help
                Maximum number of pending LLM requests.

        config AI_LLM_CONNECT_TIMEOUT_MS
            int "LLM Connect Timeout (ms)"
            default 10000
            help
                Timeout for establishing connection to LLM server.

        config AI_LLM_TOTAL_TIMEOUT_MS
            int "LLM Total Timeout (ms)"
            default 30000
            help
                Total timeout for LLM request including content generation.

        config AI_LLM_MAX_TTS_LEN
            int "Max TTS Text Length"
            default 2048
            help
                Maximum length of TTS text returned by LLM.

        config AI_LLM_MAX_PROMPT_INVENTORY
            int "Max Inventory Items in Prompt"
            default 30
            help
                Limit the number of inventory items injected into system prompt.

        config AI_LLM_MAX_PROMPT_RECIPES
            int "Max Recipe Suggestions in Prompt"
            default 5
            help
                Limit the number of recipe suggestions injected into system prompt.

        config AI_CONTEXT_CACHE_TTL_MS
            int "LLM Context Cache TTL (ms)"
            default 5000
            help
                Time-to-live for the inventory context cache used by LLM prompt builder.

        config AI_LLM_MAX_RETRIES
            int "LLM Max Retries"
            default 3
            help
                Maximum number of retries for transient LLM errors.

        config AI_LLM_RETRY_BASE_MS
            int "LLM Retry Base Delay (ms)"
            default 1000
            help
                Base delay for exponential backoff retry.

        config AI_LLM_KEY_BUF_SIZE
            int "LLM API Key Buffer Size"
            default 512
            help
                Buffer size for storing LLM API key.
    endmenu

    menu "Audio Wake Word"
        config SMART_FRIDGE_WAKE_WORD_MODEL_NAME
            string "WakeNet model name"
            default "wn9_nihaoxiaozhi_tts"
            help
                WakeNet model name loaded from the "model" partition. Leave the
                bundled default unless a custom wake-word model such as
                "xiaoxianxiaoxian" is flashed to the model partition.

        config SMART_FRIDGE_WAKE_WORD_DETECTION_MODE
            int "WakeNet detection mode"
            default 95
            range 90 95
            help
                WakeNet detection sensitivity. Higher values are stricter and
                reduce false triggers. ESP-SR 2.4.x WakeNet supports 90 and 95
                for the 1-channel direct interface.

        config SMART_FRIDGE_WAKE_WORD_TASK_STACK_SIZE
            int "Wake word task stack size"
            default 24576
            range 8192 32768
            help
                Stack size for the resident WakeNet task. WakeNet model setup,
                logging, and audio frame processing need more stack than a small
                polling task; keep this at 24 KB unless RAM pressure requires
                careful tuning.

        config SMART_FRIDGE_WAKE_WORD_IDLE_HITS
            int "Idle consecutive wake hits"
            default 1
            range 1 4
            help
                Number of WakeNet hits required while the device is idle.

        config SMART_FRIDGE_WAKE_WORD_TTS_HITS
            int "TTS barge-in consecutive wake hits"
            default 2
            range 1 5
            help
                Number of WakeNet hits required while TTS is playing. Keep this
                stricter than idle to reduce speaker-echo false triggers.

        config SMART_FRIDGE_WAKE_WORD_MIN_SNR
            int "Idle minimum RMS/noise ratio"
            default 3
            range 1 10
            help
                Minimum RMS to noise-floor ratio required for accepting a wake
                hit while idle.

        config SMART_FRIDGE_WAKE_WORD_TTS_MIN_SNR
            int "TTS minimum RMS/noise ratio"
            default 6
            range 1 16
            help
                Stricter RMS to noise-floor ratio required while TTS is playing.

        config SMART_FRIDGE_WAKE_WORD_DEBUG_ENERGY_DETECT
            bool "Enable debug energy-based wake detector"
            default n
            help
                Development-only wake detector. It triggers on sustained loud
                speech/noise so the wake-word event path can be tested before
                a real WakeNet or TFLite Micro keyword model is integrated.

        config SMART_FRIDGE_WAKE_WORD_RMS_THRESHOLD
            int "Debug wake detector RMS threshold"
            default 1800
            depends on SMART_FRIDGE_WAKE_WORD_DEBUG_ENERGY_DETECT
            help
                Minimum RMS for the development-only energy detector.

        config SMART_FRIDGE_WAKE_WORD_MIN_VOICE_MS
            int "Debug wake detector minimum voice duration"
            default 520
            depends on SMART_FRIDGE_WAKE_WORD_DEBUG_ENERGY_DETECT
            help
                Sustained voiced duration required before the debug detector
                emits a wake event.
    endmenu

    menu "Weather API Settings"
        config SMART_FRIDGE_DEFAULT_WEATHER_URL
            string "Default Weather API URL"
            default "https://devapi.qweather.com/v7/weather/now?location={location}&key={key}"
            help
                Default weather API URL. Use {location} and {key} as placeholders;
                they are replaced at runtime. Empty disables weather fetching.

        config SMART_FRIDGE_DEFAULT_WEATHER_KEY
            string "Default Weather API Key"
            default ""
            help
                Default weather API key. Can be overridden at runtime via NVS.
                WARNING: Do not commit real API keys to version control.

        config SMART_FRIDGE_DEFAULT_WEATHER_CITY
            string "Default Display City Name"
            default ""
            help
                City name shown on the dashboard (e.g. "北京"). Display only.

        config SMART_FRIDGE_DEFAULT_WEATHER_LOCATION
            string "Default Weather Location Parameter"
            default ""
            help
                Location query parameter (LocationID or "lng,lat") substituted into {location}.

        config SMART_FRIDGE_DEFAULT_WEATHER_TEMP_PATH
            string "Default Temperature JSON Path"
            default "now.temp"
            help
                Dot-separated cJSON path to extract temperature from the API response.

        config SMART_FRIDGE_DEFAULT_WEATHER_TEXT_PATH
            string "Default Weather Text JSON Path"
            default "now.text"
            help
                Dot-separated cJSON path to extract weather description text from the API response.
    endmenu

endmenu
```
