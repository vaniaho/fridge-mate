## sdkconfig.defaults
```kconfig
CONFIG_IDF_TARGET="esp32p4"

# ESP32-P4 second-stage bootloader starts at 0x2000 (first 0x2000 bytes are
# reserved for the key manager / flash-encryption metadata). If the ROM prints
# "invalid header" it usually means the bootloader was not written to this offset.
CONFIG_BOOTLOADER_OFFSET_IN_FLASH=0x2000

# Flash Size (32MB)
CONFIG_ESPTOOLPY_FLASHSIZE_32MB=y
CONFIG_ESPTOOLPY_FLASHSIZE="32MB"

# Custom Partition Table
CONFIG_PARTITION_TABLE_CUSTOM=y
CONFIG_PARTITION_TABLE_CUSTOM_FILENAME="partitions.csv"
CONFIG_PARTITION_TABLE_FILENAME="partitions.csv"
CONFIG_PARTITION_TABLE_OFFSET=0x8000

# PSRAM Support
CONFIG_SPIRAM=y
CONFIG_SPIRAM_SPEED_200M=y
CONFIG_SPIRAM_SPEED=200
CONFIG_SPIRAM_USE_MALLOC=y
CONFIG_SPIRAM_MALLOC_ALWAYSINTERNAL=0
 
# HTTP WebSocket Support
CONFIG_HTTPD_WS_SUPPORT=y

# Cloud speech gateways can return HTTP Upgrade headers larger than the
# ESP-IDF default of 1 KB. Keep an 8 KB handshake buffer only while connecting.
CONFIG_WS_BUFFER_SIZE=8192
CONFIG_WS_DYNAMIC_BUFFER=y

# HTTP, HTTPS, browser WebSockets and outbound ASR/LLM/TTS coexist.
CONFIG_LWIP_MAX_SOCKETS=16

# TLS records and WebSocket frame buffers are large. Permit fallback to PSRAM
# and allocate them only while actively sending or receiving.
# CONFIG_MBEDTLS_INTERNAL_MEM_ALLOC is not set
CONFIG_MBEDTLS_DEFAULT_MEM_ALLOC=y
CONFIG_MBEDTLS_DYNAMIC_BUFFER=y
CONFIG_ESP_WS_CLIENT_ENABLE_DYNAMIC_BUFFER=y

# LVGL Chinese Font
CONFIG_LV_FONT_SIMSUN_16_CJK=y

# Chip Revision (Support v1.x engineering samples)
CONFIG_ESP32P4_SELECTS_REV_LESS_V3=y
CONFIG_ESP32P4_REV_MIN_100=y

# FatFS Long File Names Support
CONFIG_FATFS_LFN_HEAP=y
CONFIG_FATFS_MAX_LFN=255

# LVGL FreeType# LVGL Settings
CONFIG_LV_USE_FREETYPE=y
CONFIG_LV_FONT_MONTSERRAT_16=y
CONFIG_LV_FONT_MONTSERRAT_18=y
CONFIG_LV_FONT_MONTSERRAT_24=y
CONFIG_LV_FREETYPE_CACHE_SIZE=16384
CONFIG_LV_FREETYPE_SBIT_CACHE=y
CONFIG_LV_FREETYPE_CACHE_FT_FACES=2
CONFIG_LV_FREETYPE_CACHE_FT_SIZES=2

# Use ESP-IDF malloc for LVGL to utilize PSRAM
CONFIG_LV_MEM_CUSTOM=y

# FreeRTOS tick rate: 1000 Hz gives 1 ms resolution for LVGL animations/touch
# and makes pdMS_TO_TICKS(1) actually yield in vTaskDelay.
CONFIG_FREERTOS_HZ=1000

# GUI creation performs synchronous FreeType CJK auto-hinting in app_main.
# 24 KB is large enough for that call chain while still fitting internal SRAM.
CONFIG_ESP_MAIN_TASK_STACK_SIZE=24576

# CJK font cache/render can keep the main task busy for several seconds during
# startup. Give the task watchdog a longer leash so a single FreeType render
# pass does not trigger a system reset.
CONFIG_ESP_TASK_WDT_TIMEOUT_S=15

# ESP-Hosted SDIO for ESP32-C6 co-processor (Waveshare board)
CONFIG_ESP_WIFI_REMOTE_ENABLED=y
CONFIG_ESP_WIFI_REMOTE_LIBRARY_HOSTED=y
CONFIG_SLAVE_IDF_TARGET_ESP32C6=y
CONFIG_ESP_HOSTED_SDIO_HOST_INTERFACE=y
# CONFIG_ESP_HOSTED_SPI_HOST_INTERFACE is not set
CONFIG_ESP_HOSTED_SDIO_RESET_ACTIVE_HIGH=y
CONFIG_ESP_HOSTED_SDIO_OPTIMIZATION_RX_STREAMING_MODE=y
CONFIG_ESP_HOSTED_SDIO_GPIO_RESET_SLAVE=54
CONFIG_ESP_HOSTED_SDIO_4_BIT_BUS=y
CONFIG_ESP_HOSTED_SDIO_BUS_WIDTH=4
CONFIG_ESP_HOSTED_SDIO_CLOCK_FREQ_KHZ=40000
CONFIG_ESP_HOSTED_SDIO_PIN_CMD=19
CONFIG_ESP_HOSTED_SDIO_PIN_CLK=18
CONFIG_ESP_HOSTED_SDIO_PIN_D0=14
CONFIG_ESP_HOSTED_SDIO_PRIV_PIN_D1_4BIT_BUS=15
CONFIG_ESP_HOSTED_SDIO_PIN_D1=15
CONFIG_ESP_HOSTED_SDIO_PIN_D2=16
CONFIG_ESP_HOSTED_SDIO_PIN_D3=17
CONFIG_ESP_HOSTED_GPIO_SLAVE_RESET_SLAVE=54
# Streaming voice defaults
CONFIG_SMART_FRIDGE_DEFAULT_ASR_URL="wss://openspeech.bytedance.com/api/v3/sauc/bigmodel_async"
CONFIG_SMART_FRIDGE_DEFAULT_ASR_MODEL="volc.bigasr.sauc.duration"
CONFIG_SMART_FRIDGE_DEFAULT_TTS_URL="wss://openspeech.bytedance.com/api/v3/tts/bidirection"
CONFIG_SMART_FRIDGE_DEFAULT_TTS_MODEL="zh_female_vv_jupiter_bigtts"
CONFIG_SMART_FRIDGE_DEFAULT_TTS_EXTRA="{\"resource_id\":\"seed-tts-2.0\",\"model\":\"seed-tts-2.0-standard\",\"sample_rate\":16000}"
CONFIG_SMART_FRIDGE_DEFAULT_REALTIME_URL="wss://openspeech.bytedance.com/api/v3/realtime/dialogue"
CONFIG_SMART_FRIDGE_DEFAULT_REALTIME_MODEL="1.2.1.1"
CONFIG_SMART_FRIDGE_DEFAULT_REALTIME_EXTRA="{\"appid\":\"\",\"resource_id\":\"volc.speech.dialog\",\"app_key\":\"PlgvMymc7f3tQnJ6\",\"speaker\":\"zh_female_vv_jupiter_bigtts\",\"input_mod\":\"keep_alive\"}"
```
